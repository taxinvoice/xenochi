## components/app_mibuddy/Kconfig
```kconfig
menu "MiBuddy Configuration"

    menu "WiFi Settings"

        config MIBUDDY_WIFI_SSID
            string "WiFi SSID"
            default "MyNetwork"
            help
                The SSID of the WiFi network to connect to on boot.
                Set this to your WiFi network name.

        config MIBUDDY_WIFI_PASSWORD
            string "WiFi Password"
            default "password"
            help
                The password for the WiFi network.
                Set this to your WiFi network password.

        config MIBUDDY_WIFI_RETRY_INTERVAL_MS
            int "Retry interval (ms)"
            default 5000
            help
                Interval in milliseconds between WiFi reconnection attempts.
                The device will retry forever until connected.

    endmenu

    menu "Time Sync Settings"

        config MIBUDDY_NTP_SERVER
            string "NTP Server"
            default "pool.ntp.org"
            help
                Primary NTP server for time synchronization.
                Common options: pool.ntp.org, time.google.com, time.cloudflare.com

        config MIBUDDY_TIMEZONE
            string "Timezone (POSIX format)"
            default "UTC0"
            help
                Timezone in POSIX format. Examples:
                - UTC0 (UTC, no offset)
                - EST5EDT,M3.2.0,M11.1.0 (US Eastern with DST)
                - PST8PDT,M3.2.0,M11.1.0 (US Pacific with DST)
                - CST-8 (China Standard Time)
                - GMT0BST,M3.5.0/1,M10.5.0 (UK with DST)
                - CET-1CEST,M3.5.0,M10.5.0/3 (Central Europe with DST)

        config MIBUDDY_SYNC_ON_CONNECT
            bool "Sync time when WiFi connects"
            default y
            help
                Automatically sync time when WiFi connection is established.

        config MIBUDDY_PUBLIC_DNS
            string "Public DNS Server (fallback)"
            default "1.1.1.1"
            help
                Public DNS server to use if router DNS fails.
                Set to empty string to use only router-provided DNS.
                Common options:
                - 1.1.1.1 (Cloudflare)
                - 8.8.8.8 (Google)
                - 9.9.9.9 (Quad9)

    endmenu

    menu "Input & API Settings"

        config MIBUDDY_INPUT_INTERVAL_MS
            int "Input mapper interval (ms)"
            default 100
            range 50 5000
            help
                How often the input system collects sensor data and runs the mapper.
                Lower values = more responsive but higher CPU usage.

                Common values:
                - 50ms (20Hz) - Very responsive, high CPU
                - 100ms (10Hz) - Default, good balance
                - 500ms (2Hz) - Low power mode
                - 1000ms (1Hz) - Very low power

        config MIBUDDY_API_URL
            string "API endpoint URL"
            default "http://10.0.13.101:8080/mochi/state"
            help
                HTTP endpoint for remote state decisions.
                The mochi will POST sensor data and receive state/activity response.
                Set to empty string to disable API queries.

        config MIBUDDY_STATE_HOLD_MS
            int "State hold time (ms)"
            default 1500
            range 0 5000
            help
                Minimum time to stay in a state before allowing change.
                Prevents jittery state transitions from sensor noise.

                Set to 0 to disable (instant transitions).
                Recommended: 1000-2000ms for smooth behavior.

                Note: High-priority states (PANIC, DIZZY) can still
                interrupt immediately regardless of this setting.

    endmenu

endmenu
```

## components/audio_play/Kconfig
```kconfig
menu "Audio Playback Configuration"

    config AUDIO_DEFAULT_VOLUME
        int "Default audio volume (0-100)"
        default 10
        range 0 100
        help
            The default audio volume level on boot.
            Range is 0 (mute) to 100 (maximum).
            Default is 10 for a moderate starting volume.

endmenu
```

## components/net_api/Kconfig
```kconfig
menu "Net API Configuration"

    config NET_API_TIMEOUT_MS
        int "Default request timeout (ms)"
        default 10000
        help
            Default timeout in milliseconds for HTTP requests.

    config NET_API_MAX_RESPONSE_SIZE
        int "Maximum response buffer size"
        default 8192
        help
            Maximum size in bytes for HTTP response body buffer.

    config NET_API_TASK_STACK_SIZE
        int "Async task stack size"
        default 8192
        help
            Stack size for async HTTP request tasks.

    config NET_API_MAX_HEADERS
        int "Maximum custom headers"
        default 8
        help
            Maximum number of custom headers that can be set.

endmenu
```

## components/net_mqtt/Kconfig
```kconfig
menu "Net MQTT Configuration"

    config NET_MQTT_BROKER_URI
        string "Default MQTT broker URI"
        default "mqtts://test.mosquitto.org:8883"
        help
            Default MQTT broker URI. Can be overridden at runtime.
            Supports mqtt://, mqtts://, ws://, wss:// schemes.

    config NET_MQTT_CLIENT_ID
        string "Default client ID prefix"
        default "esp32c6_"
        help
            Client ID prefix. MAC address will be appended.

    config NET_MQTT_KEEPALIVE_SEC
        int "Keep-alive interval (seconds)"
        default 60
        help
            MQTT keep-alive interval in seconds.

    config NET_MQTT_TASK_STACK_SIZE
        int "MQTT task stack size"
        default 4096
        help
            Stack size for the MQTT client task.

endmenu
```

## components/power_manager/Kconfig
```kconfig
menu "Power Manager Configuration"

    config POWER_SCREEN_OFF_TIMEOUT_SEC
        int "Screen off timeout when face-down (seconds)"
        default 60
        range 10 600
        help
            Time in seconds to wait before fading the screen off
            when the device is placed face-down.

    config POWER_LIGHT_SLEEP_TIMEOUT_SEC
        int "Light sleep timeout when face-down (seconds)"
        default 300
        range 60 1800
        help
            Time in seconds to wait before entering light sleep
            when the device is placed face-down (after screen is off).

    config POWER_IDLE_SCREEN_OFF_TIMEOUT_SEC
        int "Idle timeout before screen off (seconds)"
        default 600
        range 60 1800
        help
            Time with no touch or motion before screen turns off.
            This is separate from face-down detection timeout.

    config POWER_MOTION_POLL_INTERVAL_MS
        int "Motion polling interval during light sleep (ms)"
        default 2000
        range 500 10000
        help
            How often to wake from light sleep to check if the device
            has been picked up (accelerometer polling).

endmenu
```

## components/sd_logger/Kconfig
```kconfig
menu "SD Card Logger Configuration"

    config SD_LOGGER_DEFAULT_ENABLED
        bool "Enable logging by default"
        default n
        help
            If enabled, logging to SD card starts automatically on boot.
            Can be toggled at runtime via sd_logger_set_enabled().

    config SD_LOGGER_MAX_FILE_SIZE_KB
        int "Max log file size (KB)"
        default 1024
        range 64 8192
        help
            Maximum size of each log file in kilobytes.
            When reached, the log file is rotated.

    config SD_LOGGER_MAX_FILES
        int "Max number of log files to keep"
        default 5
        range 1 20
        help
            Number of rotated log files to keep.
            Older files are deleted when this limit is exceeded.

    config SD_LOGGER_DIRECTORY
        string "Log directory path"
        default "/sdcard/logs"
        help
            Directory on SD card where log files are stored.
            Will be created if it doesn't exist.

endmenu
```

## components/time_sync/Kconfig
```kconfig
menu "MiBuddy Time Sync Configuration"

    config MIBUDDY_NTP_SERVER
        string "NTP Server"
        default "pool.ntp.org"
        help
            Primary NTP server for time synchronization.
            Common options: pool.ntp.org, time.google.com, time.cloudflare.com

    config MIBUDDY_TIMEZONE
        string "Timezone (POSIX format)"
        default "UTC0"
        help
            Timezone in POSIX format. Examples:
            - UTC0 (UTC, no offset)
            - EST5EDT,M3.2.0,M11.1.0 (US Eastern with DST)
            - PST8PDT,M3.2.0,M11.1.0 (US Pacific with DST)
            - CST-8 (China Standard Time)
            - GMT0BST,M3.5.0/1,M10.5.0 (UK with DST)
            - CET-1CEST,M3.5.0,M10.5.0/3 (Central Europe with DST)

    config MIBUDDY_SYNC_ON_CONNECT
        bool "Sync time when WiFi connects"
        default y
        help
            Automatically sync time when WiFi connection is established.

    config MIBUDDY_PUBLIC_DNS
        string "Public DNS Server (fallback)"
        default "1.1.1.1"
        help
            Public DNS server to use if router DNS fails.
            Set to empty string to use only router-provided DNS.
            Common options:
            - 1.1.1.1 (Cloudflare)
            - 8.8.8.8 (Google)
            - 9.9.9.9 (Quad9)

endmenu
```

## main/Kconfig.projbuild
```kconfig
menu "XPowersLib Configuration"

    choice PMU_Type
        prompt "XPowers chip type"
        default XPOWERS_CHIP_AXP2101
        help
            Defines the default peripheral for xpowers example

        config XPOWERS_CHIP_AXP2101
            bool "Xpowers AXP2101"
        config XPOWERS_CHIP_AXP192
            bool "Xpowers AXP192"
    endchoice

endmenu
```

## sdkconfig.defaults
```kconfig
CONFIG_PARTITION_TABLE_CUSTOM=y
CONFIG_PARTITION_TABLE_CUSTOM_FILENAME="partitions.csv"
CONFIG_PARTITION_TABLE_FILENAME="partitions.csv"
CONFIG_PARTITION_TABLE_OFFSET=0x8000

# Increase main task stack for image decoders (JPEG needs ~12KB)
CONFIG_ESP_MAIN_TASK_STACK_SIZE=16384

# LVGL image decoders for MiBuddy app (loads images from SD card)
CONFIG_LV_USE_LODEPNG=y
# CONFIG_LV_USE_BMP is not set
# CONFIG_LV_USE_TJPGD is not set
# CONFIG_LV_USE_GIF is not set

# LVGL filesystem driver for loading images from SD card
# Uses POSIX file API with 'S' as the drive letter
# Paths like "S:Images/file.png" map to "/sdcard/Images/file.png"
CONFIG_LV_USE_FS_POSIX=y
CONFIG_LV_FS_POSIX_LETTER=83
CONFIG_LV_FS_POSIX_PATH="/sdcard/"
```
